// SPDX-License-Identifier: (GPL-2.0+ OR MIT)
/*
 * Copyright (c) 2020 Rockchip Electronics Co., Ltd.
 * Copyright (c) 2023 Radxa Limited.
 *
 */

/dts-v1/;

#include "core3566-base.dtsi"
#include "overlay/core3566-hdmi-screen.dtsi"
#include "overlay/core3566-mipi-camera-imx219-cam0.dtsi"
#include "overlay/core3566-mipi-camera-imx219-cam1.dtsi"
